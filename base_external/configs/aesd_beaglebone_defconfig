## base_external/configs/aesd_beaglebone_defconfig
```kconfig
BR2_GLOBAL_PATCH_DIR="../base_external/patches"
BR2_PACKAGE_BUSYBOX_SHOW_OTHERS=y
BR2_PACKAGE_DROPBEAR=y
BR2_PACKAGE_AESD_ASSIGNMENTS=y
```
